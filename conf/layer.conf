## conf/layer.conf
```bitbake
# We have a conf and classes directory, add to BBPATH
BBPATH .= ":${LAYERDIR}"

# We have a packages directory, add to BBFILES
BBFILES += "${LAYERDIR}/recipes-*/*/*.bb"
BBFILES += "${LAYERDIR}/recipes-*/*/*.bbappend"

BBFILE_COLLECTIONS += "dhsomextra"
BBFILE_PATTERN_dhsomextra = "^${LAYERDIR}/"
BBFILE_PRIORITY_dhsomextra = "5"

LAYERDEPENDS_dhsomextra = "core"
LAYERSERIES_COMPAT_dhsomextra = "dunfell kirkstone"

BBFILES_DYNAMIC += " \
	openembedded-layer:${LAYERDIR}/dynamic-layers/openembedded-layer/*/*/*.bb \
	openembedded-layer:${LAYERDIR}/dynamic-layers/openembedded-layer/*/*/*.bbappend \
	networking-layer:${LAYERDIR}/dynamic-layers/networking-layer/*/*/*.bb \
	networking-layer:${LAYERDIR}/dynamic-layers/networking-layer/*/*/*.bbappend \
	\
	webserver-layer:${LAYERDIR}/dynamic-layers/webserver-layer/*/*/*.bb \
	webserver-layer:${LAYERDIR}/dynamic-layers/webserver-layer/*/*/*.bbappend \
	\
	qt5-layer:${LAYERDIR}/dynamic-layers/qt5-layer/*/*/*.bb \
	qt5-layer:${LAYERDIR}/dynamic-layers/qt5-layer/*/*/*.bbappend \
	\
	qt6-layer:${LAYERDIR}/dynamic-layers/qt6-layer/*/*/*.bb \
	qt6-layer:${LAYERDIR}/dynamic-layers/qt6-layer/*/*/*.bbappend \
	\
	browser-layer:${LAYERDIR}/dynamic-layers/chromium-browser-layer/*/*/*.bb \
	browser-layer:${LAYERDIR}/dynamic-layers/chromium-browser-layer/*/*/*.bbappend \
	chromium-browser-layer:${LAYERDIR}/dynamic-layers/chromium-browser-layer/*/*/*.bb \
	chromium-browser-layer:${LAYERDIR}/dynamic-layers/chromium-browser-layer/*/*/*.bbappend \
	\
	webkit:${LAYERDIR}/dynamic-layers/webkit/*/*/*.bb \
	webkit:${LAYERDIR}/dynamic-layers/webkit/*/*/*.bbappend \
	\
	games-layer:${LAYERDIR}/dynamic-layers/games-layer/*/*/*.bb \
	games-layer:${LAYERDIR}/dynamic-layers/games-layer/*/*/*.bbappend \
	\
	meta-flutter:${LAYERDIR}/dynamic-layers/meta-flutter/*/*/*.bb \
	meta-flutter:${LAYERDIR}/dynamic-layers/meta-flutter/*/*/*.bbappend \
	\
	fsl-sdk-release:${LAYERDIR}/dynamic-layers/fsl-sdk-release/*/*/*.bb \
	fsl-sdk-release:${LAYERDIR}/dynamic-layers/fsl-sdk-release/*/*/*.bbappend \
	meta-ml:${LAYERDIR}/dynamic-layers/meta-ml/*/*/*.bb \
	meta-ml:${LAYERDIR}/dynamic-layers/meta-ml/*/*/*.bbappend \
	"

BBFILES_DYNAMIC += " \
	${@' \
	openembedded-layer:${LAYERDIR}/dynamic-layers/kirkstone/openembedded-layer/*/*/*.bb \
	openembedded-layer:${LAYERDIR}/dynamic-layers/kirkstone/openembedded-layer/*/*/*.bbappend \
	' if (d.getVar('LAYERSERIES_CORENAMES') not in ['dunfell']) else ' \
	core:${LAYERDIR}/dynamic-layers/dunfell/core/*/*/*.bb \
	core:${LAYERDIR}/dynamic-layers/dunfell/core/*/*/*.bbappend \
	\
	mainlinegraphics-layer:${LAYERDIR}/dynamic-layers/dunfell/mainlinegraphics-layer/*/*/*.bb \
	mainlinegraphics-layer:${LAYERDIR}/dynamic-layers/dunfell/mainlinegraphics-layer/*/*/*.bbappend \
	'} "
```
